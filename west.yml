## west.yml
```yaml
manifest:
  version: "0.10"
  remotes:
    - name: nordic
      url-base: https://github.com/nrfconnect
    - name: simensrostad
      url-base: https://github.com/simensrostad
  projects:
    - name: fw-nrfconnect-nrf
      path: nrf
      remote: simensrostad
      revision: add_azure_support_asset_tracker_v2
      import: true
  self:
    path: firmware
```
